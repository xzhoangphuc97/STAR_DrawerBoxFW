## sdkconfig.defaults
```kconfig
# USB Configuration
CONFIG_TINYUSB_CDC_ENABLED=y
CONFIG_USB_OTG_SUPPORTED=y
CONFIG_TINYUSB_CDC_ENABLED=y
CONFIG_TINYUSB_CDC_COUNT=1
# CONFIG_TINYUSB_MSC_ENABLED=n

# Bluetooth/BLE Configuration
CONFIG_BT_ENABLED=y
CONFIG_BT_CONTROLLER_ENABLED=y
CONFIG_BT_BLE_ENABLED=y
CONFIG_BT_BLUEDROID_ENABLED=y
CONFIG_BT_BLE_50_FEATURES_SUPPORTED=n
CONFIG_BT_BLE_SMP_ENABLE=n
CONFIG_BT_GATTS_ENABLE=y
CONFIG_BT_GATTC_ENABLE=n

# Wi-Fi Configuration (Station Mode - Minimal)
CONFIG_ESP_WIFI_ENABLED=y
CONFIG_ESP_WIFI_STATIC_RX_BUFFER_NUM=2
CONFIG_ESP_WIFI_DYNAMIC_RX_BUFFER_NUM=4
CONFIG_ESP_WIFI_AMPDU_TX_ENABLED=n
CONFIG_ESP_WIFI_AMPDU_RX_ENABLED=n

# Ethernet Configuration
CONFIG_ETH_USE_SPI_ETHERNET=y
CONFIG_LWIP_NETIF_STATUS_CALLBACK=y
CONFIG_LWIP_NETIF_LOOPBACK=y

# SPI Configuration
CONFIG_SPI_MASTER_ISR_IN_IRAM=y
CONFIG_SPI_MASTER_IN_IRAM=y

# FreeRTOS Optimization
CONFIG_FREERTOS_TASK_NOTIFICATION_ARRAY_ENTRIES=1
CONFIG_FREERTOS_MAX_TASK_NAME_LEN=8

# Memory Configuration
CONFIG_SPIRAM=n

# Partition Table Configuration
CONFIG_PARTITION_TABLE_CUSTOM=y                  # Use custom partition table
CONFIG_PARTITION_TABLE_CUSTOM_FILENAME="partitions.csv"  # Custom table filename
CONFIG_PARTITION_TABLE_FILENAME="partitions.csv"         # Actual table file

# Flash Configuration
CONFIG_ESPTOOLPY_FLASHSIZE_8MB=y

CONFIG_ESP_MAIN_TASK_STACK_SIZE=8192
```
